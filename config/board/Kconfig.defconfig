## config/boards/shields/Ideapad/Kconfig.defconfig
```kconfig
# Uncomment to enable encoder
# CONFIG_EC11=y
# CONFIG_EC11_TRIGGER_GLOBAL_THREAD=y

if SHIELD_IDEAPAD

config ZMK_KEYBOARD_NAME
 default "Ideapad"

CONFIG_BT_CTLR_TX_PWR_PLUS_8=y

endif 
```
